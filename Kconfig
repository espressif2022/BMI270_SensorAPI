## Kconfig
```kconfig
menu "IMU Sensor Selection"

choice
    prompt "Select sensor type"
    default SENSOR_BMI270

    config SENSOR_BMI220
        bool "BMI220 support"

    config SENSOR_BMI270
        bool "BMI270 support"

endchoice

endmenu
```

## test_apps/main/Kconfig.projbuild
```kconfig
menu "Example Configuration"

    config I2C_MASTER_SCL
        int "SCL GPIO Num"
        default 5
        help
            GPIO number for I2C Master clock line.

    config I2C_MASTER_SDA
        int "SDA GPIO Num"
        default 4
        help
            GPIO number for I2C Master data line.

endmenu
```
